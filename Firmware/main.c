#include <reg52.h>
#include <intrins.h>
#include <string.h> 

#include "rc522.h"

typedef unsigned char u8;
typedef unsigned int u16;

/********************************************************************
							全局变量声明
********************************************************************/
sbit steering=P2^7;				//舵机控制端口
sbit gBuzzer=P1^5;
u16 i;

u8 UID_get[5];					//调用PcdAnticoll时的参数，存放得到的卡片UID
u8 pTagType_Get[4];				//调用PcdRequest时的参数，存放得到的卡片类型代码。此程序暂时用不上。
u16 count = 0;					//控制舵机转动角度
u16 time = 0;					//计算舵机信号发送时间

/********************************************************************
							函数原型声明
********************************************************************/
void init();
void card_identify();
void delayms();
void delayus();
void beep();

/********************************************************************
							卡片信息
********************************************************************/

// {0xaa, 0xaa, 0xaa, 0xaa}格式写入卡片ID
u8 card1[5] = {};
u8 card2[5] = {};
u8 card3[5] = {};
u8 card4[5] = {};



/********************************************************************
							
********************************************************************/
void sys_init()
{
	//使用定时器0，模式1，定时时长100us
	TMOD &= 0xF0;			//设置定时器模式
	TMOD |= 0x01;			//设置定时器模式
	TL0 = 0x9C;				//设置定时初值
	TH0 = 0xFF;				//设置定时初值
	TF0 = 0;				//清除TF0标志
	TR0 = 1;				//定时器0开始计时
	EA = 1;
	ET0 = 1;
	
	TMOD = 0x21;		// T1设置为8位自动重装载定时器			
    SCON = 0x40;		// 串口工作在模式1：8位UART波特率可变，且禁止接收
    TH1 = 0xE6;			// 单片机小精灵V1.3算出的2400波特率且波特率
    TL1 = TH1;			// 加倍时的定时器设置值。
    PCON = 0x80;		// 设置为波特率加倍
	EA = 1;				// 开总中断
	ES = 1;			    // 开串口中断
	TR1 = 1;		    // 定时器1开启计数
	
	//初始化RC522模块
	gBuzzer = 0;
	PcdReset();				//复位RC522
    PcdAntennaOff(); 	 	//关天线 		
    PcdAntennaOn();  		//开天线
	M500PcdConfigISOType('A');
}

/********************************************************************
							
********************************************************************/
void steering_ctrl() interrupt 1
{
	TL0 = 0x9C;				//设置定时初值
	TH0 = 0xFF;				//设置定时初值
	TF0 = 0;				//清除TF0标志
	TR0 = 1;				//定时器0开始计时
	
	time++;
	//控制PWM脉冲宽度
	if (time < count)
		steering = 1;
	else 
		steering = 0;
	if (time>=200)
		time = 0;
}

/*********************************************************************
* 函 数 名       : delayms
* 函数功能		 : 延时
* 参数列表       : 无
* 函数输出    	 : 无
*********************************************************************/
void delayms(u8 i)
{
    unsigned char a,b,c;
	for(;i>0;i--)
 	   for(c=1;c>0;c--)
    	    for(b=142;b>0;b--)
        	    for(a=2;a>0;a--);
}


void delay100us()		//@12.000MHz
{
	unsigned char i, j;

	i = 2;
	j = 39;
	do
	{
		while (--j);
	} while (--i);
}



/********************************************************************
							
********************************************************************/
void main()
{
	sys_init();
	beep();
	
	card_identify();
}

/********************************************************************
							
********************************************************************/
void card_identify()
{
	while(1)
	{
		if (PcdRequest(0x52,pTagType_Get)==MI_OK)
		{//判断是否进行刷卡
			if (PcdAnticoll(UID_get)==MI_OK)
			{//若有刷卡，则获取卡片的UID
				if(strcmp(UID_get,card1)==0||strcmp(UID_get,card2)==0||strcmp(UID_get,card3)==0||strcmp(UID_get,card4)==0)
				{//将获取的卡片UID与有效UID比对
					beep();
					count = 10;
					delayms(1500);
					count = 20;
				}
			}
		}
	}
}


void beep()
{
	u8 a,b,i;
	for(i=2;i>0;i--){
		for(b=50;b>0;b--){
			for(a=2;a>0;a--){
				gBuzzer = 0;
				delay100us();
				gBuzzer = 1;
				delay100us();
			}
	   }
	}
}
